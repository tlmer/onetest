/dts-v1/;
/ {
    compatible = "onetest,ualink-switch";
    model = "ualink-switch-tlm";
    ualink@0 {
        compatible = "ualink,switch";
        ualink,ports = <4>;
        ualink,credit-window = <128>;
        ualink,route = <0x51 0 0x52 1 0x53 2 0x54 3>;
    };
};
